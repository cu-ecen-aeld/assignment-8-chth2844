## base_external/package/aesd-device-driver/Config.in
```kconfig
config BR2_PACKAGE_AESD_DEVICE_DRIVER
	bool "aesd-device-driver"
	help
	  contains aesd-char-driver kernel modules
```

## base_external/package/ldd/Config.in
```kconfig
config BR2_PACKAGE_LDD
	bool "ldd"
	help
		Loads linux kernel driver support packages
```
